/*----------------------------------------------------------------
//                                                              //
//  sections.lds                                                //
//                                                              //
----------------------------------------------------------------*/


ENTRY(_start)


SECTIONS {

        . = 0x0;
                        
	.text   : {  start*(.text); *(.text); *(.text.startup)}
        
	.data : { *(.data) }

}
